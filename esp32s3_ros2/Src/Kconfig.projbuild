## esp32s3_ros2/Src/Kconfig.projbuild
```kconfig
menu "ESP32-S3 ROS 2 application"
config APP_ROS_DOMAIN_ID
    int "ROS_DOMAIN_ID (same as Agent and host)"
    range 0 232
    default 0
choice APP_ROS_TRANSPORT
    prompt "micro-ROS transport"
    default APP_ROS_USB_SERIAL_JTAG
config APP_ROS_USB_SERIAL_JTAG
    bool "Native USB Serial/JTAG (GPIO19 D-, GPIO20 D+)"
config APP_ROS_UART1
    bool "UART1 with an external USB-UART adapter"
config APP_ROS_WIFI_UDP
    bool "Wi-Fi + lwIP UDP"
config APP_ROS_USB_RNDIS_UDP
    bool "USB OTG RNDIS network + lwIP UDP"
endchoice
if APP_ROS_WIFI_UDP || APP_ROS_USB_RNDIS_UDP
config APP_ROS_AGENT_IP
    string "Agent IPv4 address (reachable from MCU)"
    default "192.168.7.2" if APP_ROS_USB_RNDIS_UDP
    default "192.168.1.100"
config APP_ROS_AGENT_PORT
    int "Agent UDP port"
    range 1 65535
    default 8888
endif
if APP_ROS_WIFI_UDP
config APP_ROS_WIFI_COUNTRY
    string "Wi-Fi country code (use the deployment region)"
    default "01"
    help
        ISO country code such as CN or US; 01 is world safe mode.
        Select the deployment region to enable its permitted Wi-Fi channels.
config APP_ROS_WIFI_SSID
    string "Wi-Fi SSID"
    default ""
config APP_ROS_WIFI_PASSWORD
    string "Wi-Fi password"
    default ""
endif
if APP_ROS_USB_RNDIS_UDP
config APP_ROS_USB_DHCP_SERVER
    bool "Assign the USB host IPv4 address using DHCP"
    default y
    select LWIP_DHCPS
    help
        MCU uses 192.168.7.1/24 and offers 192.168.7.2-3 to the USB host.
        No default gateway or DNS is advertised on this direct link.
endif
if APP_ROS_UART1
config APP_ROS_UART_TX
    int "UART1 TX GPIO"
    range 0 48
    default 17
config APP_ROS_UART_RX
    int "UART1 RX GPIO"
    range 0 48
    default 18
endif
endmenu
```

## stm32f4_ros2/Src/Kconfig.projbuild
```kconfig
mainmenu "STM32F407 micro-ROS configuration"

menu "micro-ROS application"
choice ROS_TRANSPORT
    prompt "micro-ROS transport"
    default ROS_TRANSPORT_UART
config ROS_TRANSPORT_UART
    bool "USART1 DMA (PA9 TX / PA10 RX)"
config ROS_TRANSPORT_USB_RNDIS
    bool "Native USB RNDIS + UDP (PA11 D- / PA12 D+)"
endchoice

config ROS_DOMAIN_ID
    int "ROS domain ID"
    range 0 232
    default 0
config ROS_COMM_DEMO
    bool "Topic/service/action peer communication demo"
    default n
    help
        Subscribe directly to the ESP32 topics, run AddTwoInts services and
        bounded Fibonacci action client/server. Requires the expanded library.
config ROS_UART_BAUD
    int "USART1 baud rate"
    depends on ROS_TRANSPORT_UART
    range 9600 921600
    default 115200

menu "USB network"
    depends on ROS_TRANSPORT_USB_RNDIS
config USB_HSE_HZ
    int "External crystal frequency (Hz, whole MHz)"
    range 4000000 26000000
    default 8000000
    help
        Use the crystal fitted on the board. USB needs a precise 48 MHz clock.
        The reference mcu_test board uses an 8 MHz crystal.
config USB_MCU_IP
    string "MCU IPv4 address (/24)"
    default "192.168.7.3"
config USB_HOST_IP
    string "USB host DHCP address (/24)"
    default "192.168.7.4"
    help
        MCU and host must have different host addresses in the same /24.
        The DHCP offer contains no default gateway or DNS server.
        ESP32 uses MCU .1 / host .2. STM32 uses MCU .3 / host .4.
        With both USB NICs connected, add per-MCU /32 host routes.
config ROS_AGENT_IP
    string "micro-ROS Agent IPv4 address"
    default USB_HOST_IP
config ROS_AGENT_PORT
    int "micro-ROS Agent UDP port"
    range 1 65535
    default 8888
endmenu
endmenu
```
